/dts-v1/;
/plugin/;

/ {
    fragment@0 {
        target-path = "/";
        __overlay__ {
            emu68: emu68 {
                args = "";
                m68k-jit-size = <0x00000040>;
                ppc-jit-size = <0x00000040>;

                // THESE BOOLS ARE OFF BY DEFAULT!
                // ppc-enable
                // disable-fpu
                
                joymap: joystick {
                    /* Disabled unless profile_enable is supplied. */
                    fire1-bit = <0>;
                    fire2-bit = <1>;
                    fire3-bit = <2>;
                    fire4-bit = <3>;
                };

                defs: defaults {
                    insn-count = <0xffffffff>;
                    ccr-scan-depth = <0xffffffff>;
                    branch-inline-distance = <0xffffffff>;
                    chip-slowdown-distance = <0xffffffff>;

                    // THESE BOOLS ARE OFF BY DEFAULT!
                    // fast-page-zero
                    // blitter-wait
                    // dbf-slowdown
                    // chip-slowdown
                    // move-vbr
                };
            };
        };
    };

    __overrides__ {
        args = <&emu68>,"args";
        JMAP = <&joymap>,"profile-enable?";
        JF1 = <&joymap>,"fire1-bit:0";
        JF2 = <&joymap>,"fire2-bit:0";
        JF3 = <&joymap>,"fire3-bit:0";
        JF4 = <&joymap>,"fire4-bit:0";
        ppc_enable = <&emu68>,"ppc-enable?";
        ppc_jit_size = <&emu68>,"ppc-jit-size:0";
        m68k_jit_size = <&emu68>,"m68k-jit-size:0";
        no_fpu = <&emu68>,"disable-fpu?";
        vbr_move = <&defs>,"move-vbr?";
        ICNT = <&defs>,"insn-count:0";
        CCRD = <&defs>,"ccr-scan-depth:0";
        IRNG = <&defs>,"branch-inline-distance:0";
        SC = <&defs>,"chip-slowdown?";
        SCS = <&defs>,"chip-slowdown-distance:0";
        FP0 = <&defs>,"fast-page-zero?";
        BW = <&defs>,"blitter-wait?";
        DBF = <&defs>,"dbf-slowdown?";
    };
};
